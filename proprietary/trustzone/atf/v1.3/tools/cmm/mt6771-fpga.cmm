;*****************************************************************************
;  Copyright Statement:
;  --------------------
;  This software is protected by Copyright and the information contained
;  herein is confidential. The software may not be copied and the information
;  contained herein may not be used or disclosed except with the written
;  permission of MediaTek Inc. c(C) 2011
;
;*****************************************************************************
;;==========================c======================
;; PURPOSE:     FPGA Bring Up
;; CREATE_DATE: 2017/06/07
;; NOTE:
;;================================================
; Specify Core Number
;=================================================
menu.reprogram ATF_Menu.men
ENTRY &IN_MENU
;;-> <<< Menu Switch >>>
IF "&IN_MENU"=="ATF_LOAD_BIN"
(
    GOSUB
    (
    	print "loading ATF image"
		D.LOAD.BINARY ../../../../../../../../out/target/product/fpga6771_64_emmc/trustzone/bin/sram_atf.img 0x100800 /noclear
		D.LOAD.BINARY ../../../../../../../../out/target/product/fpga6771_64_emmc/trustzone/bin/dram_atf.img 0x54600000 /noclear
    )
    STOP
)
&NR_CPUS=1
; cluster 0 corebase: 0x8007000, 0x8007200, 0x8007400, 0x8007600
; cluster 1 corebase: 0x8009000, 0x8009200, 0x8009400, 0x8009600

;=================================================
; Initialize CPU
;=================================================
&WDT_TEST=0
if &WDT_TEST==0
(
	RESET
	SYSTEM.OPTION ENRESET ON
)

SYSTEM.RESET
SYSTEM.OPTION ENRESET ON
SYSTEM.OPTION RESBREAK OFF
SYSTEM.OPTION WAITRESET OFF

SYSTEM.JTAGCLOCK 10.MHz;

;SYSTEM.CPU CortexA7MPCore
SYStem.CPU CORTEXA53;

;R-T Memory Access
SYSTEM.MULTICORE MEMORYACCESSPORT 0
SYSTEM.MULTICORE DEBUGACCESSPORT 1

;SYSTEM.MULTICORE COREBASE APB:0x80070000
;Setting Core debug register access
if &NR_CPUS==1
(
    SYStem.CONFIG CORENUMBER 1;
    SYStem.CONFIG COREBASE 0x8D410000;
    SYStem.CONFIG CTIBASE 0x8D420000;
)
else
(
    SYSTEM.CONFIG CORENUMBER 2;
    SYSTEM.CONFIG COREBASE 0x80810000 0x80910000;
    SYStem.CONFIG CTIBASE 0x80820000 0x80920000;
)

;=================================================
; Attach and Stop CPU
;=================================================
SYStem.Up
wait 200.us

SETUP.IMASKHLL ON
SETUP.IMASKASM ON

;enable L2C 256KB
D.S SD:0x0C5307F0 %LE %LONG 0x00010300 ;Enable L2C share SRAM (512K)
D.S SD:0x0C5307F0 %LE %LONG 0x00010301 ;Enable L2C share SRAM (512K)

; set_hw_breakpoint_by_def
; setting attribute of breakpoints
Break.Select Program OnChip
Break.Select Hll OnChip
Break.Select Spot OnChip
Break.Select Read OnChip
Break.Select Write OnChip

D.S C15:0x1 0				; Turn off MMU

; disable wdt (debug purpose)
D.S SD:0x10007000 %LE %LONG 0x22000000

; Init DRAM
do Sylvia_FPGA_DDR.cmm

print "wtf"
print "loading preloader FORCE ATF image"
D.LOAD.BINARY ../../../../../../../../out/target/product/fpga6771_64_emmc/obj/PRELOADER_OBJ/bin/preloader_fpga6771_64_emmc_NO_GFH.bin 0x00201000 /noclear

d.load.elf ../../../../../../../../out/target/product/fpga6771_64_emmc/trustzone/ATF_OBJ/debug/bl31/bl31.elf /StripPART 3 /PATH Z:\ /nocode


Break.Select Program OnChip
Break.Select Hll OnChip
Break.Select Spot OnChip
Break.Select Read OnChip
Break.Select Write OnChip

;winclear
d.l
b.s bl31_entrypoint
r.s pc 0x00201000
R.S T 0

go

;;SYStem.Attach
;;ON PBREAK GOSUB
;;(
;;	print "loading ATF image"
;;	D.LOAD.BINARY ../../../../../../../../out/target/product/fpga6771_64_emmc/trustzone/bin/sram_atf.img 0x100800 /noclear
;;	D.LOAD.BINARY ../../../../../../../../out/target/product/fpga6771_64_emmc/trustzone/bin/dram_atf.img 0x54600000 /noclear
;;)
;;STOP


