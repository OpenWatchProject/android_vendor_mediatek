&NR_RNKS=1
;EMI

;DRAMC0_NAO
;0x10234***
;DRAMC0
;0x10230***
;DRAMC1
;0x10240***
;DDRPHY0
;0x10238***
;DDRPHY1
;0x10248***

;EMI setting
D.S SD:0x10219000 %LE %LONG 0x00025052;
D.S SD:0x10219060 %LE %LONG 0xff000400;
D.S SD:0x10219020 %LE %LONG 0x00008000;
D.S SD:0x10235000 %LE %LONG 0x00005053;
D.S SD:0x10235010 %LE %LONG 0x00000001;


;;;;;;;;;;;;;;;;;;;;;;;;;;;;;;;;;;;;;;;;;;;;;;;
D.S SD:0x10238274 %LE %LONG 0xffffffff;
D.S SD:0x10248278 %LE %LONG 0x00000000;
D.S SD:0x10248274 %LE %LONG 0xffffffff;
D.S SD:0x1023829c %LE %LONG 0x38030000;
;PLL sel

D.S SD:0x102381a0 %LE %LONG 0x00000000;
D.S SD:0x102380a0 %LE %LONG 0x00000000;
D.S SD:0x10238120 %LE %LONG 0x00000000;
D.S SD:0x102382ac %LE %LONG 0x80000006;
D.S SD:0x102481a0 %LE %LONG 0x00000000;
D.S SD:0x102480a0 %LE %LONG 0x00000000;
D.S SD:0x10248120 %LE %LONG 0x00000000;
D.S SD:0x102482ac %LE %LONG 0x80000006;
D.S SD:0x102382a0 %LE %LONG 0x00000100; ;PINMUX
D.S SD:0x102482a0 %LE %LONG 0x00000100;
D.S SD:0x10238264 %LE %LONG 0x00400000;
D.S SD:0x10238268 %LE %LONG 0x00000040;
D.S SD:0x10248264 %LE %LONG 0x00400000;
D.S SD:0x10248268 %LE %LONG 0x00000040;
D.S SD:0x10238e18 %LE %LONG 0x00000000;
D.S SD:0x10238f18 %LE %LONG 0x01010000;
D.S SD:0x10239018 %LE %LONG 0x02020000;
D.S SD:0x10238e68 %LE %LONG 0x04040000;
D.S SD:0x10238f68 %LE %LONG 0x05050000;
D.S SD:0x10239068 %LE %LONG 0x06060000;
D.S SD:0x10238ec4 %LE %LONG 0x00000c00;
D.S SD:0x10238fc4 %LE %LONG 0x00000c00;
D.S SD:0x102393c4 %LE %LONG 0x00000c00;
D.S SD:0x102394c4 %LE %LONG 0x00000c00;
D.S SD:0x10238e50 %LE %LONG 0x00000000;
D.S SD:0x10238f50 %LE %LONG 0xbbbbbbbb;
D.S SD:0x10239050 %LE %LONG 0xbbbbbbbb;
D.S SD:0x10238e54 %LE %LONG 0x00000000;
D.S SD:0x10238f54 %LE %LONG 0x0000bb00;
D.S SD:0x10239054 %LE %LONG 0x0000bb00;
D.S SD:0x10248ea0 %LE %LONG 0x00000000;
D.S SD:0x10248fa0 %LE %LONG 0x00bbbbbb;
D.S SD:0x102490a0 %LE %LONG 0x00bbbbbb;
D.S SD:0x10248ea4 %LE %LONG 0x00000000;
D.S SD:0x10248fa4 %LE %LONG 0x00000bbb;
D.S SD:0x102490a4 %LE %LONG 0x00000bbb;
D.S SD:0x10248e00 %LE %LONG 0x00000000;
D.S SD:0x10248f00 %LE %LONG 0xbbbbbbbb;
D.S SD:0x10249000 %LE %LONG 0xbbbbbbbb;
D.S SD:0x10248e04 %LE %LONG 0x00000000;
D.S SD:0x10248f04 %LE %LONG 0x0000bb00;
D.S SD:0x10249004 %LE %LONG 0x0000bb00;
D.S SD:0x10248e50 %LE %LONG 0x00000000;
D.S SD:0x10248f50 %LE %LONG 0xbbbbbbbb;
D.S SD:0x10249050 %LE %LONG 0xbbbbbbbb;
D.S SD:0x10248e54 %LE %LONG 0x00000000;
D.S SD:0x10248f54 %LE %LONG 0x0000bb00;
D.S SD:0x10249054 %LE %LONG 0x0000bb00;
D.S SD:0x10238e1c %LE %LONG 0x00000c00;
D.S SD:0x10238f1c %LE %LONG 0x00000c00;
D.S SD:0x1023901c %LE %LONG 0x00000c00;
D.S SD:0x10238e6c %LE %LONG 0x000f0f00;
D.S SD:0x10238f6c %LE %LONG 0x000f0f00;
D.S SD:0x1023906c %LE %LONG 0x000f0f00;
D.S SD:0x10248ec4 %LE %LONG 0x00000f0f;
D.S SD:0x10248fc4 %LE %LONG 0x00000f0f;
D.S SD:0x102490c4 %LE %LONG 0x00000f0f;
D.S SD:0x10248e1c %LE %LONG 0x000f0f00;
D.S SD:0x10248f1c %LE %LONG 0x000f0f00;
D.S SD:0x1024901c %LE %LONG 0x000f0f00;
D.S SD:0x10248e6c %LE %LONG 0x000f0f00;
D.S SD:0x10248f6c %LE %LONG 0x000f0f00;
D.S SD:0x1024906c %LE %LONG 0x000f0f00;
D.S SD:0x10238128 %LE %LONG 0x00001010;
D.S SD:0x1023812c %LE %LONG 0x01111010;
D.S SD:0x10238130 %LE %LONG 0x010c10d0;
D.S SD:0x1023812c %LE %LONG 0x03111010;
D.S SD:0x102381a4 %LE %LONG 0x0000008c;
;TINFO="SHL ddrphy chA reset release"
D.S SD:0x102381b0 %LE %LONG 0x00080010;  ;SER MODE
D.S SD:0x10238d04 %LE %LONG 0x00000101;
D.S SD:0x10238d08 %LE %LONG 0x00000101;
D.S SD:0x10239204 %LE %LONG 0x00000101;
D.S SD:0x10239208 %LE %LONG 0x00000101;
D.S SD:0x102380a4 %LE %LONG 0x0000008c;
D.S SD:0x102380b0 %LE %LONG 0x00080010;  ;SER MODE
D.S SD:0x10238c04 %LE %LONG 0x00000101;
D.S SD:0x10238c08 %LE %LONG 0x00000101;
D.S SD:0x10239104 %LE %LONG 0x00000101;
D.S SD:0x10239108 %LE %LONG 0x00000101;
D.S SD:0x102481a8 %LE %LONG 0x00001010;
D.S SD:0x102481ac %LE %LONG 0x01111010;
D.S SD:0x102481b0 %LE %LONG 0x010c10d0;
D.S SD:0x102481ac %LE %LONG 0x03111010;
D.S SD:0x102480a8 %LE %LONG 0x00001010;
D.S SD:0x102480ac %LE %LONG 0x01111010;
D.S SD:0x102480b0 %LE %LONG 0x010c10d0;
D.S SD:0x102480ac %LE %LONG 0x03111010;
D.S SD:0x10248128 %LE %LONG 0x00001010;
D.S SD:0x1024812c %LE %LONG 0x01111010;
D.S SD:0x10248130 %LE %LONG 0x010c10d0;
D.S SD:0x1024812c %LE %LONG 0x03111010;
;PLL
 
D.S SD:0x10238c18 %LE %LONG 0x44000000;
D.S SD:0x10239118 %LE %LONG 0x04000000;
D.S SD:0x10238c98 %LE %LONG 0x44000000;
D.S SD:0x10239198 %LE %LONG 0x04000000;
D.S SD:0x10238d18 %LE %LONG 0x44000000;
D.S SD:0x10239218 %LE %LONG 0x04000000;
D.S SD:0x10248c18 %LE %LONG 0x44000000;
D.S SD:0x10249118 %LE %LONG 0x04000000;
D.S SD:0x10248c98 %LE %LONG 0x44000000;
D.S SD:0x10249198 %LE %LONG 0x04000000;
D.S SD:0x10248d18 %LE %LONG 0x44000000;
D.S SD:0x10249218 %LE %LONG 0x04000000;
D.S SD:0x10238da0 %LE %LONG 0x00000000;
D.S SD:0x102392a0 %LE %LONG 0x00000000;
;   DLL

D.S SD:0x10238124 %LE %LONG 0x0000051e;
D.S SD:0x102481a4 %LE %LONG 0x0000051e;
;TINFO="SHL ddrphy chB reset release"
D.S SD:0x102480a4 %LE %LONG 0x0000051e;
D.S SD:0x10248124 %LE %LONG 0x0000051e;
D.S SD:0x10238194 %LE %LONG 0x00660600;
D.S SD:0x10238094 %LE %LONG 0xc0660600;
D.S SD:0x10238114 %LE %LONG 0xc0660600;
D.S SD:0x10248194 %LE %LONG 0xc0660600;
D.S SD:0x10248094 %LE %LONG 0xc0660600;
D.S SD:0x10248114 %LE %LONG 0xc0660600;
D.S SD:0x102381b8 %LE %LONG 0x00180101;
D.S SD:0x1023826c %LE %LONG 0x00000000;
D.S SD:0x102481b8 %LE %LONG 0x00180101;
D.S SD:0x1024826c %LE %LONG 0x00000000;
D.S SD:0x10238d14 %LE %LONG 0x00000000;
D.S SD:0x10239214 %LE %LONG 0x00000000;
D.S SD:0x10239714 %LE %LONG 0x00000000;
D.S SD:0x10239c14 %LE %LONG 0x00000000;
D.S SD:0x10248d14 %LE %LONG 0x00000000;
D.S SD:0x10249214 %LE %LONG 0x00000000;
D.S SD:0x10249714 %LE %LONG 0x00000000;
D.S SD:0x10249c14 %LE %LONG 0x00000000;

;wait 1.ms

D.S SD:0x1023800c %LE %LONG 0x006d0000;
D.S SD:0x10238180 %LE %LONG 0x0000000c;
D.S SD:0x10238080 %LE %LONG 0x00000009;
D.S SD:0x10238100 %LE %LONG 0x00000009;
D.S SD:0x10248180 %LE %LONG 0x00000009;
D.S SD:0x10248080 %LE %LONG 0x00000009;
D.S SD:0x10248100 %LE %LONG 0x00000009;

;wait 1.ms

D.S SD:0x10238000 %LE %LONG 0x80000000;
D.S SD:0x10238004 %LE %LONG 0x80000000;
D.S SD:0x10238004 %LE %LONG 0x00000000;

;wait 1.ms

D.S SD:0x10238da4 %LE %LONG 0x00019200;

;wait 1.ms

D.S SD:0x10238194 %LE %LONG 0x00660e00;

;wait 1.ms

D.S SD:0x10238094 %LE %LONG 0xc0660e00;
D.S SD:0x10238114 %LE %LONG 0xc0660e00;
D.S SD:0x10248194 %LE %LONG 0xc0660e00;
D.S SD:0x10248094 %LE %LONG 0xc0660e00;
D.S SD:0x10248114 %LE %LONG 0xc0660e00;
D.S SD:0x10238284 %LE %LONG 0x0000001f;

;wait 1.ms

D.S SD:0x10238124 %LE %LONG 0x0001051e;
D.S SD:0x102481a4 %LE %LONG 0x0001051e;
D.S SD:0x102480a4 %LE %LONG 0x0001051e;
D.S SD:0x10248124 %LE %LONG 0x0001051e;
D.S SD:0x102382a0 %LE %LONG 0x8100018c;
D.S SD:0x102482a0 %LE %LONG 0x8100018c;
D.S SD:0x102381b8 %LE %LONG 0x00040101;
D.S SD:0x102381b4 %LE %LONG 0x00000000;
D.S SD:0x102380b4 %LE %LONG 0x00000000;
D.S SD:0x10238134 %LE %LONG 0x00000000;
D.S SD:0x10238c1c %LE %LONG 0x00200000; ; WJ: LP3
D.S SD:0x102481b4 %LE %LONG 0x00000000;
D.S SD:0x102480b4 %LE %LONG 0x00000000;
D.S SD:0x10248134 %LE %LONG 0x00000000;
D.S SD:0x10248c1c %LE %LONG 0x00200000; ; WJ: LP3
D.S SD:0x102300dc %LE %LONG 0x00051008;
;;D.S SD:0x1024000dc %LE %LONG 0x00050008;
D.S SD:0x10230000 %LE %LONG 0x02101000; ;[24]=LP2_EN , [25]=LP3_EN,  [26]=LP4_EN
D.S SD:0x10230640 %LE %LONG 0xa688049f;
D.S SD:0x10230660 %LE %LONG 0x00030053;
D.S SD:0x1023004c %LE %LONG 0x25712000;
D.S SD:0x10230680 %LE %LONG 0x00000000;
D.S SD:0x10230684 %LE %LONG 0x00000000;
D.S SD:0x10230688 %LE %LONG 0x00000000;
D.S SD:0x1023068c %LE %LONG 0x00000000;
D.S SD:0x10230690 %LE %LONG 0x11111011;
D.S SD:0x10230694 %LE %LONG 0x01101111;
D.S SD:0x10230698 %LE %LONG 0x11111111;
D.S SD:0x1023069c %LE %LONG 0x11111111;
D.S SD:0x102306a0 %LE %LONG 0x11111111; ;TXDLY DQS
D.S SD:0x102306a4 %LE %LONG 0x66667777;
D.S SD:0x1023082c %LE %LONG 0x11111111; ;TXDLY DQ
D.S SD:0x10230830 %LE %LONG 0x11111111; ;TXDLY DQM
D.S SD:0x10230834 %LE %LONG 0x66667777;
D.S SD:0x10230838 %LE %LONG 0x66667777;
D.S SD:0x1023092c %LE %LONG 0x11111111; 0x22222222
D.S SD:0x10230930 %LE %LONG 0x11111111; 0x22222222
D.S SD:0x10230934 %LE %LONG 0x66667777;
D.S SD:0x10230938 %LE %LONG 0x66667777;
D.S SD:0x10230a2c %LE %LONG 0x11111111; ;0x22222222
D.S SD:0x10230a30 %LE %LONG 0x11111111; ;0x22222222
D.S SD:0x10230a34 %LE %LONG 0x66667777;
D.S SD:0x10230a38 %LE %LONG 0x66667777;
D.S SD:0x1023081c %LE %LONG 0x00000000;
D.S SD:0x10230820 %LE %LONG 0x00000000;
D.S SD:0x1023091c %LE %LONG 0x00000000;
D.S SD:0x10230920 %LE %LONG 0x00000000;
D.S SD:0x10230a1c %LE %LONG 0x00000000;
D.S SD:0x10230a20 %LE %LONG 0x66666666;

;wait 1.ms
D.S SD:0x10240060 %LE %LONG 0x00000000;
D.S SD:0x10240060 %LE %LONG 0x00000000;
D.S SD:0x10240060 %LE %LONG 0x00000000;


D.S SD:0x10230200 %LE %LONG 0xf0100000; ;[31]=DQSIEN MODE
D.S SD:0x10230048 %LE %LONG 0x08000000;
D.S SD:0x10230678 %LE %LONG 0xc0000000;
D.S SD:0x10230600 %LE %LONG 0x09030b06;
D.S SD:0x10230604 %LE %LONG 0x14090901;
D.S SD:0x10230608 %LE %LONG 0x0c050201;
D.S SD:0x1023060c %LE %LONG 0x00490019;
D.S SD:0x10230614 %LE %LONG 0x01000606;
D.S SD:0x1023061c %LE %LONG 0x02030408;
D.S SD:0x10230620 %LE %LONG 0x02000400;
D.S SD:0x10230648 %LE %LONG 0x9007320f;
D.S SD:0x10230644 %LE %LONG 0x00000b0d; ;DATLAT
D.S SD:0x10230000 %LE %LONG 0x02111000; ;[24]=LP2_EN , [25]=LP3_EN,  [26]=LP4_EN
D.S SD:0x10230004 %LE %LONG 0x20002000;
D.S SD:0x10230008 %LE %LONG 0x81080000;
D.S SD:0x1023000c %LE %LONG 0x0002cf13;
D.S SD:0x10230010 %LE %LONG 0x00000080;
D.S SD:0x10230020 %LE %LONG 0x00000009;
D.S SD:0x10230024 %LE %LONG 0x80030000;
D.S SD:0x10230038 %LE %LONG 0x80000106;
D.S SD:0x10230040 %LE %LONG 0x3000000c;
D.S SD:0x1023004c %LE %LONG 0x25714001;
D.S SD:0x10230064 %LE %LONG 0x25b1f1cf; ;REFRDIS=1
D.S SD:0x102300b0 %LE %LONG 0x04300000;
D.S SD:0x10230200 %LE %LONG 0xf0310000; ;[31]=DQSIEN MODE
D.S SD:0x10230658 %LE %LONG 0x21200001;
D.S SD:0x10230800 %LE %LONG 0x00000002;
D.S SD:0x10230900 %LE %LONG 0x00000002;
D.S SD:0x10230a00 %LE %LONG 0x00000002;

;wait 1.ms
D.S SD:0x10240060 %LE %LONG 0x00000000;
D.S SD:0x10240060 %LE %LONG 0x00000000;
D.S SD:0x10240060 %LE %LONG 0x00000000;

D.S SD:0x10230824 %LE %LONG 0x10101010;   ;GATE WINDOW unit:2T
D.S SD:0x10230828 %LE %LONG 0x17171717;
D.S SD:0x10230924 %LE %LONG 0x10101010;   ;0x11111111
D.S SD:0x10230928 %LE %LONG 0x17171717;   ;0x42424242
D.S SD:0x10230a24 %LE %LONG 0x32323232;
D.S SD:0x10230a28 %LE %LONG 0x06060606;
;;D.S SD:0x10240a24 %LE %LONG 0x00000000;  ;GATE WINDOW unit:2T
;;D.S SD:0x10240a28 %LE %LONG 0x53535353;
;;D.S SD:0x10240b24 %LE %LONG 0x32323232;
;;D.S SD:0x10240b28 %LE %LONG 0x06060606;
;;D.S SD:0x10240c24 %LE %LONG 0x32323232;
;;D.S SD:0x10240c28 %LE %LONG 0x06060606;
;               33961 === over_write_setting_begin ===
;               33961 === over_write_setting_end ===
D.S SD:0x10230034 %LE %LONG 0x00731010;
D.S SD:0x10230024 %LE %LONG 0x80030050;

;wait 1.ms
D.S SD:0x10240060 %LE %LONG 0x00000000;
D.S SD:0x10240060 %LE %LONG 0x00000000;
D.S SD:0x10240060 %LE %LONG 0x00000000;
D.S SD:0x10240060 %LE %LONG 0x00000000;
D.S SD:0x10240060 %LE %LONG 0x00000000;
D.S SD:0x10240060 %LE %LONG 0x00000000;
D.S SD:0x10240060 %LE %LONG 0x00000000;
D.S SD:0x10240060 %LE %LONG 0x00000000;
D.S SD:0x10240060 %LE %LONG 0x00000000;

D.S SD:0x1023005c %LE %LONG 0x00003f00;
D.S SD:0x10230060 %LE %LONG 0x00000001;

;wait 1.ms
D.S SD:0x10240060 %LE %LONG 0x00000000;
D.S SD:0x10240060 %LE %LONG 0x00000000;
D.S SD:0x10240060 %LE %LONG 0x00000000;
D.S SD:0x10240060 %LE %LONG 0x00000000;
D.S SD:0x10240060 %LE %LONG 0x00000000;
D.S SD:0x10240060 %LE %LONG 0x00000000;
D.S SD:0x10240060 %LE %LONG 0x00000000;
D.S SD:0x10240060 %LE %LONG 0x00000000;
D.S SD:0x10240060 %LE %LONG 0x00000000;

D.S SD:0x10230060 %LE %LONG 0x00000000;

;wait 1.ms
D.S SD:0x10240060 %LE %LONG 0x00000000;
D.S SD:0x10240060 %LE %LONG 0x00000000;
D.S SD:0x10240060 %LE %LONG 0x00000000;
D.S SD:0x10240060 %LE %LONG 0x00000000;
D.S SD:0x10240060 %LE %LONG 0x00000000;
D.S SD:0x10240060 %LE %LONG 0x00000000;
D.S SD:0x10240060 %LE %LONG 0x00000000;
D.S SD:0x10240060 %LE %LONG 0x00000000;
D.S SD:0x10240060 %LE %LONG 0x00000000;

D.S SD:0x1023005c %LE %LONG 0x00000aff;
D.S SD:0x10230060 %LE %LONG 0x00000001;

;wait 1.ms
D.S SD:0x10240060 %LE %LONG 0x00000000;
D.S SD:0x10240060 %LE %LONG 0x00000000;
D.S SD:0x10240060 %LE %LONG 0x00000000;
D.S SD:0x10240060 %LE %LONG 0x00000000;
D.S SD:0x10240060 %LE %LONG 0x00000000;
D.S SD:0x10240060 %LE %LONG 0x00000000;
D.S SD:0x10240060 %LE %LONG 0x00000000;
D.S SD:0x10240060 %LE %LONG 0x00000000;
D.S SD:0x10240060 %LE %LONG 0x00000000;

D.S SD:0x10230060 %LE %LONG 0x00000000;

;wait 1.ms
D.S SD:0x10240060 %LE %LONG 0x00000000;
D.S SD:0x10240060 %LE %LONG 0x00000000;
D.S SD:0x10240060 %LE %LONG 0x00000000;
D.S SD:0x10240060 %LE %LONG 0x00000000;
D.S SD:0x10240060 %LE %LONG 0x00000000;
D.S SD:0x10240060 %LE %LONG 0x00000000;
D.S SD:0x10240060 %LE %LONG 0x00000000;
D.S SD:0x10240060 %LE %LONG 0x00000000;
D.S SD:0x10240060 %LE %LONG 0x00000000;

D.S SD:0x1023005c %LE %LONG 0x00000183;
D.S SD:0x10230060 %LE %LONG 0x00000001;

;wait 1.ms
D.S SD:0x10240060 %LE %LONG 0x00000000;
D.S SD:0x10240060 %LE %LONG 0x00000000;
D.S SD:0x10240060 %LE %LONG 0x00000000;
D.S SD:0x10240060 %LE %LONG 0x00000000;
D.S SD:0x10240060 %LE %LONG 0x00000000;
D.S SD:0x10240060 %LE %LONG 0x00000000;
D.S SD:0x10240060 %LE %LONG 0x00000000;
D.S SD:0x10240060 %LE %LONG 0x00000000;
D.S SD:0x10240060 %LE %LONG 0x00000000;

D.S SD:0x10230060 %LE %LONG 0x00000000;
D.S SD:0x1023005c %LE %LONG 0x00000206;  ;RL/WL
D.S SD:0x10230060 %LE %LONG 0x00000001;

;wait 1.ms
D.S SD:0x10240060 %LE %LONG 0x00000000;
D.S SD:0x10240060 %LE %LONG 0x00000000;
D.S SD:0x10240060 %LE %LONG 0x00000000;
D.S SD:0x10240060 %LE %LONG 0x00000000;
D.S SD:0x10240060 %LE %LONG 0x00000000;
D.S SD:0x10240060 %LE %LONG 0x00000000;
D.S SD:0x10240060 %LE %LONG 0x00000000;
D.S SD:0x10240060 %LE %LONG 0x00000000;
D.S SD:0x10240060 %LE %LONG 0x00000000;

D.S SD:0x10230060 %LE %LONG 0x00000000;   
D.S SD:0x10230028 %LE %LONG 0x00000034;
D.S SD:0x1023005c %LE %LONG 0x00000b03;  
D.S SD:0x10230060 %LE %LONG 0x00000001;

;=============================RANK1 MRW==================

;wait 1.ms
D.S SD:0x10240060 %LE %LONG 0x00000000;
D.S SD:0x10240060 %LE %LONG 0x00000000;
D.S SD:0x10240060 %LE %LONG 0x00000000;
D.S SD:0x10240060 %LE %LONG 0x00000000;
D.S SD:0x10240060 %LE %LONG 0x00000000;
D.S SD:0x10240060 %LE %LONG 0x00000000;
D.S SD:0x10240060 %LE %LONG 0x00000000;
D.S SD:0x10240060 %LE %LONG 0x00000000;
D.S SD:0x10240060 %LE %LONG 0x00000000;

D.S SD:0x10230060 %LE %LONG 0x00000000;   
D.S SD:0x1023005c %LE %LONG 0x01003f00;  
D.S SD:0x10230060 %LE %LONG 0x00000001;
;wait 1.ms
D.S SD:0x10240060 %LE %LONG 0x00000000;
D.S SD:0x10240060 %LE %LONG 0x00000000;
D.S SD:0x10240060 %LE %LONG 0x00000000;
D.S SD:0x10240060 %LE %LONG 0x00000000;
D.S SD:0x10240060 %LE %LONG 0x00000000;
D.S SD:0x10240060 %LE %LONG 0x00000000;
D.S SD:0x10240060 %LE %LONG 0x00000000;
D.S SD:0x10240060 %LE %LONG 0x00000000;
D.S SD:0x10240060 %LE %LONG 0x00000000;

D.S SD:0x10230060 %LE %LONG 0x00000000;   
;wait 1.ms
D.S SD:0x10240060 %LE %LONG 0x00000000;
D.S SD:0x10240060 %LE %LONG 0x00000000;
D.S SD:0x10240060 %LE %LONG 0x00000000;
D.S SD:0x10240060 %LE %LONG 0x00000000;
D.S SD:0x10240060 %LE %LONG 0x00000000;
D.S SD:0x10240060 %LE %LONG 0x00000000;
D.S SD:0x10240060 %LE %LONG 0x00000000;
D.S SD:0x10240060 %LE %LONG 0x00000000;
D.S SD:0x10240060 %LE %LONG 0x00000000;

   
D.S SD:0x1023005c %LE %LONG 0x01000aff;
D.S SD:0x10230060 %LE %LONG 0x00000001;

;wait 1.ms
D.S SD:0x10240060 %LE %LONG 0x00000000;
D.S SD:0x10240060 %LE %LONG 0x00000000;
D.S SD:0x10240060 %LE %LONG 0x00000000;
D.S SD:0x10240060 %LE %LONG 0x00000000;
D.S SD:0x10240060 %LE %LONG 0x00000000;
D.S SD:0x10240060 %LE %LONG 0x00000000;
D.S SD:0x10240060 %LE %LONG 0x00000000;
D.S SD:0x10240060 %LE %LONG 0x00000000;
D.S SD:0x10240060 %LE %LONG 0x00000000;

D.S SD:0x10230060 %LE %LONG 0x00000000;

;wait 1.ms
D.S SD:0x10240060 %LE %LONG 0x00000000;
D.S SD:0x10240060 %LE %LONG 0x00000000;
D.S SD:0x10240060 %LE %LONG 0x00000000;
D.S SD:0x10240060 %LE %LONG 0x00000000;
D.S SD:0x10240060 %LE %LONG 0x00000000;
D.S SD:0x10240060 %LE %LONG 0x00000000;
D.S SD:0x10240060 %LE %LONG 0x00000000;
D.S SD:0x10240060 %LE %LONG 0x00000000;
D.S SD:0x10240060 %LE %LONG 0x00000000;

D.S SD:0x1023005c %LE %LONG 0x01000183;
D.S SD:0x10230060 %LE %LONG 0x00000001;

;wait 1.ms
D.S SD:0x10240060 %LE %LONG 0x00000000;
D.S SD:0x10240060 %LE %LONG 0x00000000;
D.S SD:0x10240060 %LE %LONG 0x00000000;
D.S SD:0x10240060 %LE %LONG 0x00000000;
D.S SD:0x10240060 %LE %LONG 0x00000000;
D.S SD:0x10240060 %LE %LONG 0x00000000;
D.S SD:0x10240060 %LE %LONG 0x00000000;
D.S SD:0x10240060 %LE %LONG 0x00000000;
D.S SD:0x10240060 %LE %LONG 0x00000000;

D.S SD:0x10230060 %LE %LONG 0x00000000;
D.S SD:0x1023005c %LE %LONG 0x01000206;  ;RL/WL
D.S SD:0x10230060 %LE %LONG 0x00000001;

;wait 1.ms
D.S SD:0x10240060 %LE %LONG 0x00000000;
D.S SD:0x10240060 %LE %LONG 0x00000000;
D.S SD:0x10240060 %LE %LONG 0x00000000;
D.S SD:0x10240060 %LE %LONG 0x00000000;
D.S SD:0x10240060 %LE %LONG 0x00000000;
D.S SD:0x10240060 %LE %LONG 0x00000000;
D.S SD:0x10240060 %LE %LONG 0x00000000;
D.S SD:0x10240060 %LE %LONG 0x00000000;
D.S SD:0x10240060 %LE %LONG 0x00000000;

D.S SD:0x10230060 %LE %LONG 0x00000000;
D.S SD:0x1023005c %LE %LONG 0x01000b03; 
D.S SD:0x10230060 %LE %LONG 0x00000001;
;;wait 1.ms
D.S SD:0x10240060 %LE %LONG 0x00000000;
D.S SD:0x10240060 %LE %LONG 0x00000000;
D.S SD:0x10240060 %LE %LONG 0x00000000;
D.S SD:0x10240060 %LE %LONG 0x00000000;
D.S SD:0x10240060 %LE %LONG 0x00000000;
D.S SD:0x10240060 %LE %LONG 0x00000000;
D.S SD:0x10240060 %LE %LONG 0x00000000;
D.S SD:0x10240060 %LE %LONG 0x00000000;
D.S SD:0x10240060 %LE %LONG 0x00000000;
;================== end RANK1 MRW =====================


D.S SD:0x10230060 %LE %LONG 0x00000000;
D.S SD:0x10230024 %LE %LONG 0x80030040;

;wait 1.ms
D.S SD:0x10240060 %LE %LONG 0x00000000;
D.S SD:0x10240060 %LE %LONG 0x00000000;
D.S SD:0x10240060 %LE %LONG 0x00000000;
D.S SD:0x10240060 %LE %LONG 0x00000000;
D.S SD:0x10240060 %LE %LONG 0x00000000;
D.S SD:0x10240060 %LE %LONG 0x00000000;
D.S SD:0x10240060 %LE %LONG 0x00000000;
D.S SD:0x10240060 %LE %LONG 0x00000000;
D.S SD:0x10240060 %LE %LONG 0x00000000;


D.S SD:0x1023005c %LE %LONG 0x00000400;

  

D.S SD:0x1023064c %LE %LONG 0x00000005;

;wait 1.ms
D.S SD:0x10240060 %LE %LONG 0x00000000;
D.S SD:0x10240060 %LE %LONG 0x00000000;
D.S SD:0x10240060 %LE %LONG 0x00000000;
D.S SD:0x10240060 %LE %LONG 0x00000000;
D.S SD:0x10240060 %LE %LONG 0x00000000;
D.S SD:0x10240060 %LE %LONG 0x00000000;
D.S SD:0x10240060 %LE %LONG 0x00000000;
D.S SD:0x10240060 %LE %LONG 0x00000000;
D.S SD:0x10240060 %LE %LONG 0x00000000;

D.S SD:0x1023004c %LE %LONG 0x25774001;
D.S SD:0x10230034 %LE %LONG 0x00731810;
D.S SD:0x10230024 %LE %LONG 0x80030000;
D.S SD:0x10230004 %LE %LONG 0x20082000;
D.S SD:0x10230058 %LE %LONG 0x00000a56;

;wait 1.ms
D.S SD:0x10240060 %LE %LONG 0x00000000;
D.S SD:0x10240060 %LE %LONG 0x00000000;
D.S SD:0x10240060 %LE %LONG 0x00000000;
D.S SD:0x10240060 %LE %LONG 0x00000000;
D.S SD:0x10240060 %LE %LONG 0x00000000;
D.S SD:0x10240060 %LE %LONG 0x00000000;
D.S SD:0x10240060 %LE %LONG 0x00000000;
D.S SD:0x10240060 %LE %LONG 0x00000000;
D.S SD:0x10240060 %LE %LONG 0x00000000;


D.S SD:0x1023064c %LE %LONG 0x00ff0005;
D.S SD:0x10230064 %LE %LONG 0x25b1f1cf; ;REFRDIS=1
D.S SD:0x10230610 %LE %LONG 0x22653055;
D.S SD:0x1023004c %LE %LONG 0x45774001;
D.S SD:0x10230048 %LE %LONG 0x48000000;
D.S SD:0x1023005c %LE %LONG 0x80000400;
D.S SD:0x10230038 %LE %LONG 0xc0000107;
D.S SD:0x1023020c %LE %LONG 0x00010002;
D.S SD:0x10230204 %LE %LONG 0x00014e00;
D.S SD:0x10230094 %LE %LONG 0x00100000;
D.S SD:0x10230098 %LE %LONG 0x00004000;
D.S SD:0x1023009c %LE %LONG 0x12010480;
;               54377 === DE initial sequence done ===

;selftest
;D.S SD:0x1023009C %LE %LONG 0x02010080;
;D.S SD:0x10230094 %LE %LONG 0x00100000;
;D.S SD:0x10230098 %LE %LONG 0x00004000;
;D.S SD:0x1023009C %LE %LONG 0x82010080;
;wait 1.ms
D.S SD:0x10240060 %LE %LONG 0x00000000;
D.S SD:0x10240060 %LE %LONG 0x00000000;
D.S SD:0x10240060 %LE %LONG 0x00000000;
D.S SD:0x10240060 %LE %LONG 0x00000000;
D.S SD:0x10240060 %LE %LONG 0x00000000;
D.S SD:0x10240060 %LE %LONG 0x00000000;
D.S SD:0x10240060 %LE %LONG 0x00000000;
D.S SD:0x10240060 %LE %LONG 0x00000000;
D.S SD:0x10240060 %LE %LONG 0x00000000;
D.S SD:0x10240060 %LE %LONG 0x00000000;
D.S SD:0x10240060 %LE %LONG 0x00000000;
D.S SD:0x10240060 %LE %LONG 0x00000000;
D.S SD:0x10240060 %LE %LONG 0x00000000;
D.S SD:0x10240060 %LE %LONG 0x00000000;
D.S SD:0x10240060 %LE %LONG 0x00000000;
D.S SD:0x10240060 %LE %LONG 0x00000000;
D.S SD:0x10240060 %LE %LONG 0x00000000;
D.S SD:0x10240060 %LE %LONG 0x00000000;
