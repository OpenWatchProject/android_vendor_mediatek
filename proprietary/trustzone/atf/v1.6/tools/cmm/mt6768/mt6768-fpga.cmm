;*****************************************************************************
;  Copyright Statement:
;  --------------------
;  This software is protected by Copyright and the information contained
;  herein is confidential. The software may not be copied and the information
;  contained herein may not be used or disclosed except with the written
;  permission of MediaTek Inc. (C) 2011
;
;*****************************************************************************
;;================================================
;; PURPOSE:     FPGA Bring Up
;; CREATE_DATE: 2018/09/26
;; NOTE:
;;================================================
; Specify Core Number
;=================================================
&FPGA_LDVT=0
&NR_CPUS=1
; cluster 0 corebase: 0x8007000, 0x8007200, 0x8007400, 0x8007600
; cluster 1 corebase: 0x8009000, 0x8009200, 0x8009400, 0x8009600

;=================================================
; Initialize CPU
;=================================================
SYStem.RESet;
SYStem.Option ENRESET ON;
SYStem.Option ResBreak OFF;
SYStem.Option WaitReset 100.ms;

SYStem.JtagClock 10.MHz;

SYStem.CPU Ananke;

if &NR_CPUS==1
(
    SYStem.CONFIG CORENUMBER 1;
	SYStem.CONFIG COREBASE 0x8E010000;
	SYStem.CONFIG CTIBASE 0x8E020000;
)
else
(
    ;SYSTEM.CONFIG CORENUMBER 8;
    ;SYStem.CONFIG COREBASE 0x8E010000 0x8E110000 0x8E210000 0x8E310000 0x8E410000 0x8E510000 0x8E610000 0x8E710000;
    ;SYStem.CONFIG CTIBASE  0x8E020000 0x8E120000 0x8E220000 0x8E320000 0x8E420000 0x8E520000 0x8E620000 0x8E720000;
    SYSTEM.CONFIG CORENUMBER 2;
    SYStem.CONFIG COREBASE 0x8E010000 0x8E610000 ;
    SYStem.CONFIG CTIBASE  0x8E020000 0x8E620000;
)

;=================================================
; Attach and Stop CPU
;=================================================
SYSTEM.UP

SETUP.IMASKHLL ON
SETUP.IMASKASM ON

;=================================================
; Initialize EMI
;=================================================
&init_emi=1 ; 0: not init
            ; 1: init
IF &init_emi==1
(
    do MT6768_FPGA_DDR.cmm
)
;=================================================
; register
;=================================================
&RGU=0x10007000

;=================================================
; disable wdt (debug purpose)
;=================================================
D.S SD:&RGU+0x0000 %LE %LONG 0x22000064

; for pmic power latch (RGU + 0xA4)
D.S SD:&RGU+0x00A4 %LE %LONG 0x66000001


; L3C share enable
D.S SD:0x0C53C8D0 %LE %LONG 0x00070300

; MSDC FPGA DTB: Card power(GPIO3), MSDC Bus 3.3V(GPIO2), MSDC Bus 1.8V(GPIO1) control
; Set GPIO direction
;D.S SD:0x10001E88 %LE %LONG 0xFF00
; Set GPIO output value
;D.S SD:0x10001E84 %LE %LONG 0x5500

; set_hw_breakpoint_by_def
; setting attribute of breakpoints
Break.Select Program OnChip
Break.Select Hll OnChip
Break.Select Spot OnChip
Break.Select Read OnChip
Break.Select Write OnChip

D.S C15:0x1 0				; Turn off MMU

; disable wdt (debug purpose)
D.S SD:0x10007000 %LE %LONG 0x22000000


R.S T 0

if &FPGA_LDVT==1
(
; board init
print "loading ATF elf symbol"
;d.load.elf ../../../../../../../../../out/target/product/fpga6768_64/trustzone/ATF_OBJ/debug/bl31/bl31.elf /StripPART 4 /PATH L:\ /nocode
;d.load.elf ../../../../../../../../../out/target/product/fpga6768_64/trustzone/ATF_OBJ/debug/bl31/bl31.elf /StripPART 4 /PATH L:\ /noclear
d.load.elf ../../../../../custom/build/out/fpga6768_64/trustzone/ATF_OBJ/debug/bl31/bl31.elf /StripPART 4 /PATH L:\ /noclear


PRINT "Load preloader BIN(Binary Only)..."
;D.LOAD.BINARY ./bin/preloader_fpga6768_64_emmc_NO_GFH.bin 0x00201000 /noclear
;data.load.elf boot-a64.elf /gnu /noclear /nosymbol
print "loading warm reset bootloader..."
data.load.elf fpga_bl.axf /gnu /noclear /nosymbol
)
else
(
D.LOAD.BINARY L:\chun5_alps-dev-p0.mp1-talbot\vendor\mediatek\proprietary\bootable\bootloader\lk\build-fpga6768_64\lk-no-mtk-header.bin 0x56000000 /noclear
DATA.LOAD.ELF L:\chun5_alps-dev-p0.mp1-talbot\vendor\mediatek\proprietary\bootable\bootloader\lk\build-fpga6768_64\lk /StripPART 3 /PATH Z:\ /nocode


print "loading ATF elf symbol"
;d.load.elf ../../../../../../../../../out/target/product/fpga6768_64/trustzone/ATF_OBJ/debug/bl31/bl31.elf /StripPART 4 /PATH L:\ /nocode
;d.load.elf ../../../../../../../../../out/target/product/fpga6768_64/trustzone/ATF_OBJ/debug/bl31/bl31.elf /StripPART 4 /PATH L:\ /noclear
d.load.elf ../../../../../custom/build/out/fpga6768_64/trustzone/ATF_OBJ/debug/bl31/bl31.elf /StripPART 4 /PATH L:\ /noclear


print "loading pre-loader image"
;d.load.elf ../../../../../../../../../out/target/product/fpga6768_64/obj/PRELOADER_OBJ/bin/preloader_fpga6768_64.elf  /noclear
d.load.elf ../../../../../../../../../out/target/product/fpga6768_64/obj/PRELOADER_SBOOT_DIS_OBJ/bin/preloader_fpga6768_64_SBOOT_DIS.elf  /noclear

r.s pc 0x00201000
)

;core.select 1
;r.s pc 0x110000
;core.select 0

;b.s bl31_entrypoint
;b.s bl31_main

Break.Select Program OnChip
Break.Select Hll OnChip
Break.Select Spot OnChip
Break.Select Read OnChip
Break.Select Write OnChip

;R.S T 0
;winclear
d.l
enddo
