;*****************************************************************************
;  Copyright Statement:
;  --------------------
;  This software is protected by Copyright and the information contained
;  herein is confidential. The software may not be copied and the information
;  contained herein may not be used or disclosed except with the written
;  permission of MediaTek Inc. (C) 2011
;
;*****************************************************************************
;;================================================
;; PURPOSE:     EVB Bring Up
;; CREATE_DATE: 2015/12/10
;; NOTE:
;;================================================
; Specify Core Number
;=================================================

&NR_CPUS=1
; cluster 0 corebase: 0x8007000, 0x8007200, 0x8007400, 0x8007600
; cluster 1 corebase: 0x8009000, 0x8009200, 0x8009400, 0x8009600

;=================================================
; Initialize CPU
;=================================================
&WDT_TEST=0
if &WDT_TEST==0
(
	RESET
	SYSTEM.OPTION ENRESET ON
)

SYSTEM.RESET
SYSTEM.OPTION ENRESET ON
SYSTEM.OPTION RESBREAK OFF
SYSTEM.OPTION WAITRESET OFF

SYSTEM.JTAGCLOCK 10.MHz;

;SYSTEM.CPU CortexA7MPCore
SYStem.CPU CORTEXA53;

;R-T Memory Access
SYSTEM.MULTICORE MEMORYACCESSPORT 0
SYSTEM.MULTICORE DEBUGACCESSPORT 1

;SYSTEM.MULTICORE COREBASE APB:0x80070000
;Setting Core debug register access
if &NR_CPUS==1
(
    SYStem.CONFIG CORENUMBER 1;
    SYStem.CONFIG COREBASE 0x80410000;
    SYStem.CONFIG CTIBASE 0x80420000;
)
else
(
    SYSTEM.CONFIG CORENUMBER 2;
    SYSTEM.CONFIG COREBASE 0x80810000 0x80910000;
    SYStem.CONFIG CTIBASE 0x80820000 0x80920000;
)

;=================================================
; Attach and Stop CPU
;=================================================
SYStem.Up
wait 200.us

SETUP.IMASKHLL ON
SETUP.IMASKASM ON

;Disable acinactm
;d.s c:0x1020002c  %le %long 0x8
;d.s c:0x1020022c  %le %long 0x8


;=================================================
; Initialize EMI
;=================================================
&init_emi=0 ; 0: not init
            ; 1: init
IF &init_emi==1
(
; Init DDR
;do MTxxxx_FPGA_DDR.cmm
  do OLYMPUS_FPGA_DDR_1G
  wait 3000.ms
)


;D.S SD:0x00000000 %LE %LONG 0xEAFFFFFE
;D.S SD:0x10006000 %LE %LONG 0x0b160001
;D.S SD:0x100062A0 %LE %LONG 0x7C
;D.S SD:0x100062B0 %LE %LONG 0x7C


;enable L2C 256KB
D.S SD:0x10200000 %LE %LONG 0x00000100 ;Enable L2C share SRAM, cluster 0
D.S SD:0x10200000 %LE %LONG 0x00001100 ;Enable L2C share SRAM, cluster 0

;enable DMA access on L2C share path
D.S SD:0x1000108c %LE %LONG 0x00404400 ;l2c_sram_cg_clr bit 22 set 1


; MSDC FPGA DTB: Card power(GPIO3), MSDC Bus 3.3V(GPIO2), MSDC Bus 1.8V(GPIO1) control
; Set GPIO direction
;D.S SD:0x10001E88 %LE %LONG 0xFF00
; Set GPIO output value
;D.S SD:0x10001E84 %LE %LONG 0x5500

; set_hw_breakpoint_by_def
; setting attribute of breakpoints
Break.Select Program OnChip
Break.Select Hll OnChip
Break.Select Spot OnChip
Break.Select Read OnChip
Break.Select Write OnChip

D.S C15:0x1 0				; Turn off MMU

; disable wdt (debug purpose)
D.S SD:0x10007000 %LE %LONG 0x22000000

; board init

Register.Set T 0 ; must

;set break point for tiny bootloader deadloop position
;b.s 0x205922

;PRINT "Wait preloader Enter while(1);"
;GO
;WAIT 3.s

;d.load.elf ../../bin/preloader.elf
; ABTC change the ouput folder
;
PRINT "Load preloader BIN(Binary Only)..."
;D.LOAD.ELF ../../../../../bootable/bootloader/preloader/bin/preloader.elf /noclear
;D.LOAD.ELF ../../../../../../../../out/target/product/fpga6757_64/obj/PRELOADER_OBJ/bin/preloader_fpga6757_64.elf /noclear
;D.LOAD.BINARY ./bin/preloader_evb6757_64_NO_GFH.bin 0x00201000 /noclear
D.LOAD.BINARY ../../../../../../../../out/target/product/evb6757_64/obj/PRELOADER_OBJ/bin/preloader_evb6757_64_NO_GFH.bin 0x00201000 /noclear

; normal virsion lk
;D.LOAD.BINARY ../../../../../out/target/product/mtxxxx_fpga/obj/BOOTLOADER_OBJ/build-mtxxxx_fpga/lk-no-mtk-header.bin 0x41E00000 /noclear
;D.LOAD.BINARY ../../../../../out/target/product/evb6735_64_atf1/obj/BOOTLOADER_OBJ/build-evb6735_64_atf1/lk-no-mtk-header.bin 0x41E00000 /noclear
;D.LOAD.BINARY ./bin/mt6797_lk-no-mtk-header.bin 0x41E00000 /noclear
;d.load.elf ../../../../../out/target/product/fpga_everest_64/obj/BOOTLOADER_OBJ/build-fpga_everest_64/lk /noclear

; simple uart log in lk
;D.LOAD.BINARY ../../tools/cmm/bin/simple_uart_log_lk-no-mtk-header.bin 0x46000000 /noclear
;D.LOAD.BINARY ../../tools/cmm/bin/lk-no-mtk-header.bin 0x46000000 /noclear
D.LOAD.BINARY ../../../../../../../../out/target/product/evb6757_64/obj/BOOTLOADER_OBJ/build-evb6757_64/lk-no-mtk-header.bin 0x46000000 /noclear

PRINT "Load ATF ELF..."
;d.load.elf ../../../out/build/debug/bl31/bl31.elf
d.load.elf ../../../../../../../../out/target/product/evb6757_64/trustzone/ATF_OBJ/debug/bl31/bl31.elf /noclear

; /noclear means no clear symbol table
;d.load.elf ../../../../out/target/product/mtxxxx_fpga/obj/PRELOADER_OBJ/bin/preloader.elf /nocode

r.s pc 0x00201000

Register.Set T 0 ; must

PRINT "Wait preloader Enter while(1);"
;GO
;WAIT 3.s

Y.SPATH.RESET ; reset all source path
Y.SPATH.SRD ../../bl31
Y.SPATH.SRD ../../plat/mediatek/mt6757
Y.SPATH.SRD ../../services/spd/tspd
Y.SPATH.SRD ../../services/std_svc/psci
Y.SPATH.SRD ../../lib/aarch64

Break.Select Program OnChip
Break.Select Hll OnChip
Break.Select Spot OnChip
Break.Select Read OnChip
Break.Select Write OnChip

;set break point
;b.s 0x43001000
;b.s 0x205922
;b.s enable_mmu_el3
;b.s bl31_main
;b.s el3_exit
;b.s 0x4000c000
;b.s 0x00111000
;b.s 0x41E00000
b.s errata_a53_826319_wa

R.S T 0
;winclear
d.l
enddo
