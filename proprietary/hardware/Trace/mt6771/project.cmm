global &project
&project="k71v1_64_bsp"
