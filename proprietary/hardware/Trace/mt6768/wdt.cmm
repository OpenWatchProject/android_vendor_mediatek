;AP WDT disable
d.s asd:0x10007000 %le %long 0x22000064

