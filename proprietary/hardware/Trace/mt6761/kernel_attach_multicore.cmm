SYStem.Down
system.reset
SYSTEM.OPTION ENRESET OFF
SYStem.Option ResBreak OFF
SYStem.Option WaitReset OFF

SYSTEM.CONFIG CORENUMBER 4;
SYStem.CONFIG COREBASE 0x8D410000 0x8D510000 0x8D610000 0x8D710000;
SYStem.CONFIG CTIBASE  0x8D420000 0x8D520000 0x8D620000 0x8D720000;
CORE.ASSIGN 1 2 3 4

SYStem.Up
