SYStem.Down
system.reset
SYSTEM.OPTION ENRESET OFF
SYStem.Option ResBreak OFF
SYStem.Option WaitReset OFF

SYSTEM.CONFIG CORENUMBER 8;
SYStem.CONFIG COREBASE 0x8D410000 0x8D510000 0x8D610000 0x8D710000 0x8D810000 0x8D910000 0x8DA10000 0x8DB10000;
SYStem.CONFIG CTIBASE  0x8D420000 0x8D520000 0x8D620000 0x8D720000 0x8D820000 0x8D920000 0x8DA20000 0x8DB20000;
CORE.ASSIGN 1 2 3 4 5 6 7 8

SYStem.Up
