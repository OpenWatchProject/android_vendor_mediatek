do project.cmm
; =========================================
; Please DO NOT modify this section - START
; =========================================
SYStem.Down
system.reset
SYSTEM.OPTION ENRESET ON
SYStem.Option ResBreak OFF
SYStem.Option WaitReset OFF
SYStem.JtagClock 10.MHz

SYStem.CPU CORTEXA53;

;Setting Core debug register access
SYSTEM.CONFIG CORENUMBER 8;
SYStem.CONFIG COREBASE 0x80410000 0x80510000 0x80610000 0x80710000 0x80810000 0x80910000 0x80A10000 0x80B10000;
SYStem.CONFIG CTIBASE  0x80420000 0x80520000 0x80620000 0x80720000 0x80820000 0x80920000 0x80A20000 0x80B20000;
CORE.ASSIGN 1 2 3 4 5 6 7 8


;; Parallel Interface
System.CONFIG SWDP OFF

SYStem.Up

SETUP.IMASKASM	ON          ; Disbale interrupt during assembly step
SETUP.IMASKHLL	ON          ; Disbale interrupt during C step

MMU.OFF

print "[INFO][MAIN] Watchdog Disabled"

do wdt.cmm  ; disable hw watchdog timer

Break.SELect Program OnChip ; set_hw_breakpoint_by_def   Jau add
Break.SELect Read OnChip
Break.SELect Write OnChip

Break.Delete
sYmbol.RESet

TrOnchip.Set DABORT OFF        ; used by Linux for page miss!
TrOnchip.Set SWI OFF
TrOnchip.Set PABORT OFF        ; used by Linux for page miss!
TrOnchip.Set UNDEF OFF         ; used to detect non-existent coprocessor

&KernelPATH="../../../../../../../out/target/product/&project/obj/KERNEL_OBJ"
print "[INFO][MAIN] Loading Linux Kernel Symbols ..."
sYmbol.SourcePATH.RESet
&searchStr="/alps/"
&pathlen=STRing.SCAN(OS.PWD(),"&searchStr",0)+STRing.LEN("&searchStr")-1
&alpsPath=STRing.MID(OS.PWD(), 0, &pathlen)
Data.LOAD.Elf &KernelPATH/vmlinux /gnu /nocode /StripPART "&searchStr" /PATH "&alpsPath"

task.config Linux
;menu.reprogram Linux
menu.reprogram watchdog

B::
TOOLBAR ON
STTUSBAR ON
;WINPAGE.RESET

WINPOS 0.125 0.125 100. 30. 13. 1. W000
WINTABS 16. 10. 25. 62.
;WINPAGE.SELECT P000


Break.Delete
;B.set start_kernel

d.l
go

while ISRUN()
(
)

on pbreak gosub
(
	if data.long(asd:0x10007000)!=0x00000000
	(
		do wdt.cmm
		print "Watchdog disabled"
		return
	)
)

stop
end
