do project.cmm
; =========================================
; Please DO NOT modify this section - START
; =========================================
SYSTEM.Reset
SYStem.CPU CORTEXA53;
System.Option Cflush ON    	;flush the cache to avoid data consistency
SYSTEM.OPTION ENRESET ON
SYSTEM.OPTION TRST ON
SYStem.Option ResBreak OFF
SYStem.Option WaitReset OFF
SYStem.JtagClock 5MHz

;R-T Memory Access
SYSTEM.MULTICORE MEMORYACCESSPORT 0
SYSTEM.MULTICORE DEBUGACCESSPORT 1

;Setting Core debug register access
SYStem.CONFIG COREBASE 0x8D410000;
SYStem.CONFIG CTIBASE  0x8D420000;

sys.mode go
wait 500.ms
sys.mode down
wait 100.ms
sys.mode up
;SYStem.Up

setup.IMASKHLL ON
setup.IMASKASM ON

;Register.REset

;D.S C15:0x1 0				; Turn off MMU

Break.SELect Program OnChip ; set_hw_breakpoint_by_def   Jau add
;Break.SELect Hll OnChip     ; setting attribute of breakpoints
;Break.SELect Spot OnChip
Break.SELect Read OnChip
Break.SELect Write OnChip

print "loading Preloader"

&PLPATH="../../../../../../out/target/product/&project/obj/PRELOADER_OBJ/bin"

Y.SPATH.RESET ; reset all source path

print "Loading Preloader symbols..."
sYmbol.SourcePATH.RESet
&searchStr="/alps/"
&pathlen=STRing.SCAN(OS.PWD(),"&searchStr",0)+STRing.LEN("&searchStr")-1
&alpsPath=STRing.MID(OS.PWD(), 0, &pathlen)
Data.LOAD.Elf &PLPATH/preloader_&project.elf /gnu /nocode /StripPART "&searchStr" /PATH "&alpsPath"

screen.on
area.reset

Break.Delete
B.set main
do wdt.cmm  ; disable hw watchdog timer

go
;go main /Onchip
;wait !run()

B::
TOOLBAR ON
STTUSBAR ON
;WINPAGE.RESET

WINPOS 0.125 0.125 100. 30. 13. 1. W000
WINTABS 16. 10. 25. 62.
d.l
;WINPAGE.SELECT P000
